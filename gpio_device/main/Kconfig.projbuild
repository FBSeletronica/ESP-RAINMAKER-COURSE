## gpio_device/main/Kconfig.projbuild
```kconfig
menu "Example Configuration"

    config EXAMPLE_BOARD_BUTTON_GPIO
        int "Boot Button GPIO"
        default 9 if IDF_TARGET_ESP32C3 || IDF_TARGET_ESP32C6 || IDF_TARGET_ESP32C2
        default 0
        help
            GPIO number on which the "Boot" button is connected. This is generally used
            by the application for custom operations like toggling states, resetting to defaults, etc.

    config EXAMPLE_OUTPUT_GPIO_RELAY1
        int "Relay 1"
        default 12
        help
            Control relay 1 output. Need to connect this GPIO to the relay.


endmenu
```
